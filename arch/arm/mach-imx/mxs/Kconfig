## arch/arm/mach-imx/mxs/Kconfig
```kconfig
if ARCH_MX23

config MX23
	bool
	default y

choice
	prompt "MX23 board select"
	optional

config TARGET_MX23_OLINUXINO
	bool "Support mx23_olinuxino"
	select BOARD_EARLY_INIT_F

config TARGET_MX23EVK
	bool "Support mx23evk"
	select BOARD_EARLY_INIT_F

config TARGET_XFI3
	bool "Support xfi3"

endchoice

config SYS_SOC
	default "mxs"

source "board/olimex/mx23_olinuxino/Kconfig"
source "board/freescale/mx23evk/Kconfig"

endif

if ARCH_MX28

config MX28
	bool
	default y

choice
	prompt "MX28 board select"
	optional

config TARGET_BG0900
	bool "Support bg0900"

config TARGET_MX28EVK
	bool "Support mx28evk"
	select BOARD_EARLY_INIT_F

config TARGET_XEA
	bool "Support XEA"

config TARGET_PWSH1
	bool "Support PW-SH1"
	select BOARD_EARLY_INIT_F

config TARGET_PWSH2
	bool "Support PW-SH2"
	select BOARD_EARLY_INIT_F

config TARGET_PWSH3
	bool "Support PW-SH3"
	select BOARD_EARLY_INIT_F

config TARGET_PWSH4
	bool "Support PW-SH4"
	select BOARD_EARLY_INIT_F

config TARGET_PWSH5
	bool "Support PW-SH5"
	select BOARD_EARLY_INIT_F

config TARGET_PWSH6
	bool "Support PW-SH6"
	select BOARD_EARLY_INIT_F

config TARGET_PWSH7
	bool "Support PW-SH7"
	select BOARD_EARLY_INIT_F

config TARGET_PWA7200
	bool "Support PW-A7200 series"
	help
	  Compatible with:
	   PW-G4200, PW-G5200, PW-G5300, PW-A7200, PW-A7300, PW-A7400,
	   PW-A9100, PW-A9200, PW-A9300
	select BOARD_EARLY_INIT_F

endchoice

config SYS_SOC
	default "mxs"

source "board/freescale/mx28evk/Kconfig"
source "board/liebherr/xea/Kconfig"
source "board/ppcag/bg0900/Kconfig"
source "board/sharp/pwsh1/Kconfig"
source "board/sharp/pwsh2/Kconfig"
source "board/sharp/pwsh3/Kconfig"
source "board/sharp/pwsh4/Kconfig"
source "board/sharp/pwsh5/Kconfig"
source "board/sharp/pwsh6/Kconfig"
source "board/sharp/pwsh7/Kconfig"
source "board/sharp/pwa7200/Kconfig"

endif
```

## board/sharp/common/Kconfig
```kconfig
config BRAIN_2G
	bool
	default y if TARGET_PWA7200 || TARGET_PWA7400

config BRAIN_3G_4G
	bool
	default y if TARGET_PWSH1 || TARGET_PWSH2 || TARGET_PWSH3 || \
	TARGET_PWSH4 || TARGET_PWSH5 || TARGET_PWSH6 || TARGET_PWSH7

config LCD_X
	string "LCD resolution X"
	default 480 if TARGET_PWA7200 || TARGET_PWA7400
	default 800 if TARGET_PWSH1 || TARGET_PWSH2
	default 854 if TARGET_PWSH3 || TARGET_PWSH4 || TARGET_PWSH5 || \
    TARGET_PWSH6 || TARGET_PWSH7

config LCD_Y
	string "LCD resolution Y"
	default 320 if TARGET_PWA7200 || TARGET_PWA7400
	default 480 if TARGET_PWSH1 || TARGET_PWSH2 || TARGET_PWSH3 || \
	TARGET_PWSH4 || TARGET_PWSH5 || TARGET_PWSH6 || TARGET_PWSH7
```

## board/sharp/pwa7200/Kconfig
```kconfig
if TARGET_PWA7200

config SYS_BOARD
	default "pwa7200"

config SYS_VENDOR
	default "sharp"

config SYS_SOC
	default "mxs"

config SYS_CONFIG_NAME
	default "pwa7200"

endif

source "board/sharp/common/Kconfig"
```

## board/sharp/pwa7400/Kconfig
```kconfig
if TARGET_PWA7400

config SYS_BOARD
	default "pwa7400"

config SYS_VENDOR
	default "sharp"

config SYS_SOC
	default "mxs"

config SYS_CONFIG_NAME
	default "pwa7400"

endif

source "board/sharp/common/Kconfig"
```

## board/sharp/pwg4200/Kconfig
```kconfig
if TARGET_PWG4200

config SYS_BOARD
	default "pwg4200"

config SYS_VENDOR
	default "sharp"

config SYS_SOC
	default "mxs"

config SYS_CONFIG_NAME
	default "pwg4200"

endif

source "board/sharp/common/Kconfig"
```

## configs/pwh1_defconfig
```kconfig
CONFIG_ARM=y
CONFIG_ARCH_MX7ULP=y
CONFIG_SYS_TEXT_BASE=0x60000000
CONFIG_NR_DRAM_BANKS=1
CONFIG_ENV_SIZE=0x2000
CONFIG_ENV_OFFSET=0xC0000
CONFIG_DM_GPIO=y
CONFIG_DEFAULT_DEVICE_TREE="imx7ulp-pwh1"
CONFIG_TARGET_PWH1=y
CONFIG_SYS_EXTRA_OPTIONS="IMX_CONFIG=board/sharp/pwh1/imximage.cfg"
CONFIG_BOARD_EARLY_INIT_F=y
CONFIG_HUSH_PARSER=y
CONFIG_CMD_BOOTZ=y
CONFIG_CMD_DM=y
CONFIG_CMD_GPIO=y
CONFIG_CMD_MMC=y
CONFIG_CMD_CACHE=y
CONFIG_CMD_FAT=y
CONFIG_OF_CONTROL=y
CONFIG_ENV_OVERWRITE=y
CONFIG_ENV_IS_IN_MMC=y
CONFIG_SYS_RELOC_GD_ENV_ADDR=y
# CONFIG_NET is not set
CONFIG_DM=y
CONFIG_BOUNCE_BUFFER=y
CONFIG_IMX_RGPIO2P=y
# CONFIG_MXC_GPIO is not set
CONFIG_SUPPORT_EMMC_BOOT=y
CONFIG_FSL_USDHC=y
CONFIG_MTD=y
CONFIG_PINCTRL=y
CONFIG_PINCTRL_IMX7ULP=y
CONFIG_DM_REGULATOR=y
CONFIG_DM_REGULATOR_FIXED=y
CONFIG_DM_REGULATOR_GPIO=y
CONFIG_DM_SERIAL=y
CONFIG_FSL_LPUART=y
CONFIG_DM_VIDEO=y
CONFIG_CONSOLE_ROTATION=y
CONFIG_SYS_WHITE_ON_BLACK=y
CONFIG_VIDEO_SIMPLE=y
CONFIG_SPLASH_SCREEN=y
```

## configs/pwsh2_defconfig
```kconfig
CONFIG_ARM=y
CONFIG_ARCH_MX28=y
CONFIG_SYS_TEXT_BASE=0x40200000
CONFIG_SPL_GPIO_SUPPORT=y
CONFIG_SPL_LIBCOMMON_SUPPORT=y
CONFIG_SPL_LIBGENERIC_SUPPORT=y
CONFIG_NR_DRAM_BANKS=1
CONFIG_ENV_SIZE=0x4000
CONFIG_SPL_TEXT_BASE=0x00001000
CONFIG_TARGET_PWSH2=y
CONFIG_SPL_SERIAL_SUPPORT=y
CONFIG_SPL=y
CONFIG_USE_PREBOOT=y
CONFIG_DEFAULT_FDT_FILE="imx28-pwsh2.dtb"
# CONFIG_DISPLAY_BOARDINFO is not set
CONFIG_ARCH_MISC_INIT=y
# CONFIG_SPL_FRAMEWORK is not set
CONFIG_HUSH_PARSER=y
CONFIG_CMD_BOOTZ=y
CONFIG_CMD_GPIO=y
CONFIG_CMD_MMC=y
CONFIG_CMD_CACHE=y
CONFIG_CMD_EXT4=y
CONFIG_CMD_EXT4_WRITE=y
CONFIG_CMD_FAT=y
CONFIG_CMD_FS_GENERIC=y
CONFIG_ENV_OVERWRITE=y
CONFIG_SYS_RELOC_GD_ENV_ADDR=y
# CONFIG_NET is not set
CONFIG_MXS_GPIO=y
CONFIG_MMC_MXS=y
CONFIG_CONS_INDEX=0
CONFIG_VIDEO=y
CONFIG_SPLASH_SCREEN=y
CONFIG_VIDEO_BMP_GZIP=y
CONFIG_VIDEO_BMP_RLE8=y
CONFIG_OF_LIBFDT=y
```

## configs/pwsh7_defconfig
```kconfig
CONFIG_ARM=y
CONFIG_ARCH_MX28=y
CONFIG_SYS_TEXT_BASE=0x40200000
CONFIG_SPL_GPIO_SUPPORT=y
CONFIG_SPL_LIBCOMMON_SUPPORT=y
CONFIG_SPL_LIBGENERIC_SUPPORT=y
CONFIG_NR_DRAM_BANKS=1
CONFIG_ENV_SIZE=0x4000
CONFIG_ENV_OFFSET=0x40000
CONFIG_SPL_TEXT_BASE=0x00001000
CONFIG_TARGET_PWSH7=y
CONFIG_SPL_SERIAL_SUPPORT=y
CONFIG_SPL=y
CONFIG_DEFAULT_FDT_FILE="imx28-pwsh7.dtb"
# CONFIG_CONSOLE_MUX is not set
# CONFIG_DISPLAY_BOARDINFO is not set
CONFIG_ARCH_MISC_INIT=y
# CONFIG_SPL_FRAMEWORK is not set
CONFIG_HUSH_PARSER=y
CONFIG_CMD_BOOTZ=y
CONFIG_CMD_GPIO=y
CONFIG_CMD_MMC=y
CONFIG_CMD_CACHE=y
CONFIG_CMD_EXT4=y
CONFIG_CMD_EXT4_WRITE=y
CONFIG_CMD_FAT=y
CONFIG_CMD_FS_GENERIC=y
CONFIG_ENV_OVERWRITE=y
CONFIG_ENV_IS_IN_MMC=y
CONFIG_SYS_RELOC_GD_ENV_ADDR=y
# CONFIG_NET is not set
CONFIG_MXS_GPIO=y
CONFIG_MMC_MXS=y
CONFIG_CONS_INDEX=0
CONFIG_VIDEO=y
CONFIG_SPLASH_SCREEN=y
CONFIG_VIDEO_BMP_GZIP=y
CONFIG_VIDEO_BMP_RLE8=y
CONFIG_OF_LIBFDT=y
```
